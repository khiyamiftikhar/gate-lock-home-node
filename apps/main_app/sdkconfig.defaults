## apps/main_app/sdkconfig.defaults
```kconfig
# Default sdkconfig parameters to use the OTA
# partition table layout, with a 4MB flash size
CONFIG_ESPTOOLPY_FLASHSIZE_4MB=y
#Because was crashing on ota reboot saying "A stack overflow in task sys_evt has been detected"
CONFIG_ESP_SYSTEM_EVENT_TASK_STACK_SIZE=4096
CONFIG_BOOTLOADER_APP_ROLLBACK_ENABLE=y

CONFIG_LOG_DEFAULT_LEVEL_INFO=y
#CONFIG_LOG_DEFAULT_LEVEL=4


CONFIG_PARTITION_TABLE_CUSTOM=y
CONFIG_PARTITION_TABLE_CUSTOM_FILENAME="../../partitions_custom.csv"

#Dynamic buffer required bcz contiguous mem not available for mbedtls
CONFIG_MBEDTLS_CERTIFICATE_BUNDLE=y
CONFIG_MBEDTLS_CERTIFICATE_BUNDLE_DEFAULT_NONE=y
CONFIG_MBEDTLS_CUSTOM_CERTIFICATE_BUNDLE=y
CONFIG_MBEDTLS_CUSTOM_CERTIFICATE_BUNDLE_PATH="../../components/ota-service/cert/ca_cert.pem"
CONFIG_MBEDTLS_CERTIFICATE_BUNDLE_MAX_CERTS=200


CONFIG_MBEDTLS_DYNAMIC_BUFFER=y
```

## components/mdns-service/Kconfig.projbuild
```kconfig
menu "mDNS Configuration"

config MDNS_HOSTNAME
    string "mDNS Hostname"
    default "homelock"
    help
        The hostname used for mDNS advertising. 
        This will be used as 'hostname.local' when discovering the ESP32.

config MDNS_INSTANCE_NAME
    string "mDNS Instance Name"
    default "Home Lock"
    help
        A human-readable name shown when the device is discovered 
        via mDNS (e.g., in network scanners or Bonjour browser).

endmenu
```

## components/ota-service/KConfig.projbuild
```kconfig
menu "OTA SERVICE"

    config FIRMWARE_URL
        string "Firmware manifest URL"

        default "https://khiyamiftikhar.github.io/gate-lock-home-node/ota/beta/ota-manifest-esp32.json"        if IDF_TARGET_ESP32
        default "https://khiyamiftikhar.github.io/gate-lock-home-node/ota/ota-manifest-esp32c3.json"      if IDF_TARGET_ESP32C3
        #default "https://khiyamiftikhar.github.io/gate-lock-home-node/ota/beta/ota-manifest-esp32s3.json" if IDF_TARGET_ESP32S3
        #default "https://khiyamiftikhar.github.io/gate-lock-home-node/ota/beta/ota-manifest-esp32s2.json" if IDF_TARGET_ESP32S2
        #default "https://khiyamiftikhar.github.io/gate-lock-home-node/ota/beta/ota-manifest.json"         # fallback if target not matched
        help
            The OTA link to download binary from

    config AUTO_CHECK_DURATION
        int "duration_in_hrs"
        default 24
        help
            Time in hours after which it will check for new firmware

endmenu
```

## sdkconfig.defaults
```kconfig
# Default sdkconfig parameters to use the OTA
# partition table layout, with a 4MB flash size
CONFIG_ESPTOOLPY_FLASHSIZE_4MB=y
#Because was crashing on ota reboot saying "A stack overflow in task sys_evt has been detected"
CONFIG_ESP_SYSTEM_EVENT_TASK_STACK_SIZE=4096
```

## sdkconfig.defaults.esp32c3
```kconfig
#GUI enable
CONFIG_FEATURE_GUI=n



#pins 9 and 2 are bootstrap
CONFIG_SD_SPI_HOST=1
CONFIG_SD_SPI_MOSI=10
CONFIG_SD_SPI_MISO=5    
CONFIG_SD_SPI_SCLK=8
CONFIG_SD_SPI_CS=7
CONFIG_SD_MOUNT_POINT="/sdcard"
```

## sdkconfig.defaults.esp32s3
```kconfig
# ===== Flash =====
CONFIG_ESPTOOLPY_FLASHSIZE_16MB=y

# ===== Logging =====
CONFIG_LOG_DEFAULT_LEVEL_INFO=y

# ===== System / FreeRTOS =====
CONFIG_ESP_SYSTEM_EVENT_TASK_STACK_SIZE=8192
CONFIG_FREERTOS_CHECK_STACKOVERFLOW_CANARY=y

# ===== Bootloader / OTA =====
#CONFIG_BOOTLOADER_APP_ROLLBACK_ENABLE=y
#CONFIG_APP_ROLLBACK_ENABLE=y
#CONFIG_BOOTLOADER_WDT_ENABLE=y

# ===== PSRAM (Octal, 8MB) =====
CONFIG_ESP32S3_SPIRAM_SUPPORT=y
CONFIG_SPIRAM=y
CONFIG_SPIRAM_MODE_OCT=y
CONFIG_SPIRAM_SPEED_80M=y
CONFIG_SPIRAM_USE_MALLOC=y
CONFIG_SPIRAM_MALLOC_ALWAYSINTERNAL=16384
CONFIG_SPIRAM_TRY_ALLOCATE_WIFI_LWIP=y

# ===== TLS / mbedTLS =====
#CONFIG_ESP_TLS_USING_MBEDTLS=y
#CONFIG_MBEDTLS_DYNAMIC_BUFFER=y
#CONFIG_MBEDTLS_SSL_MAX_CONTENT_LEN=16384

# ===== Wi-Fi =====
#CONFIG_ESP32_WIFI_DYNAMIC_RX_BUFFER_NUM=32
#CONFIG_ESP32_WIFI_DYNAMIC_TX_BUFFER_NUM=32

# ===== Debug =====
CONFIG_HEAP_POISONING_LIGHT=y

#=====Compiler Optimizations === #disable bcz casing problem
CONFIG_COMPILER_OPTIMIZATION_DEBUG=y
CONFIG_COMPILER_OPTIMIZATION_LEVEL_DEBUG=y
CONFIG_COMPILER_OPTIMIZATION_ASSERTIONS_ENABLE=y


# Use built-in factory + OTA partition table
CONFIG_PARTITION_TABLE_CUSTOM=n
CONFIG_PARTITION_TABLE_SINGLE_APP=n
CONFIG_PARTITION_TABLE_TWO_OTA=y
CONFIG_PARTITION_TABLE_APP_SIZE=0x200000
```
